// Nokia5110TestMain.c
// Runs on LM4F120/TM4C123
// Test the functions in Nokia5110.c by printing various
// things to the LCD.
// Daniel Valvano
// September 16, 2013
    
// Font table, initialization, and other functions based
// off of Nokia_5110_Example from Spark Fun:
// 7-17-2011
// Spark Fun Electronics 2011
// Nathan Seidle
// http://dlnmh9ip6v2uc.cloudfront.net/datasheets/LCD/Monochrome/Nokia_5110_Example.pde

/* This example accompanies the book
   "Embedded Systems: Real Time Interfacing to Arm Cortex M Microcontrollers",
   ISBN: 978-1463590154, Jonathan Valvano, copyright (c) 2014

 Copyright 2014 by Jonathan W. Valvano, valvano@mail.utexas.edu
    You may use, edit, run or distribute this file
    as long as the above copyright notice remains
 THIS SOFTWARE IS PROVIDED "AS IS".  NO WARRANTIES, WHETHER EXPRESS, IMPLIED
 OR STATUTORY, INCLUDING, BUT NOT LIMITED TO, IMPLIED WARRANTIES OF
 MERCHANTABILITY AND FITNESS FOR A PARTICULAR PURPOSE APPLY TO THIS SOFTWARE.
 VALVANO SHALL NOT, IN ANY CIRCUMSTANCES, BE LIABLE FOR SPECIAL, INCIDENTAL,
 OR CONSEQUENTIAL DAMAGES, FOR ANY REASON WHATSOEVER.
 For more information about my classes, my research, and my books, see
 http://users.ece.utexas.edu/~valvano/
 */

// Blue Nokia 5110
// ---------------
// Signal        (Nokia 5110) LaunchPad pin
// Reset         (RST, pin 1) connected to PA7
// SSI0Fss       (CE,  pin 2) connected to PA3
// Data/Command  (DC,  pin 3) connected to PA6
// SSI0Tx        (Din, pin 4) connected to PA5
// SSI0Clk       (Clk, pin 5) connected to PA2
// 3.3V          (Vcc, pin 6) power
// back light    (BL,  pin 7) not connected
// Ground        (Gnd, pin 8) ground

// Red SparkFun Nokia 5110 (LCD-10168)
// -----------------------------------
// Signal        (Nokia 5110) LaunchPad pin
// 3.3V          (VCC, pin 1) power
// Ground        (GND, pin 2) ground
// SSI0Fss       (SCE, pin 3) connected to PA3
// Reset         (RST, pin 4) connected to PA7
// Data/Command  (D/C, pin 5) connected to PA6
// SSI0Tx        (DN,  pin 6) connected to PA5
// SSI0Clk       (SCLK, pin 7) connected to PA2
// back light    (LED, pin 8) not connected

#include <stdint.h>
#include <math.h>
#include "TIMER0.h"
#include "Nokia5110.h"
#include "PLL.h"
#include "RS232.h"
#include "ST7735.h"
#include "PWM.h"
#include "ADC.h"

// delay function for testing from sysctl.c
// which delays 3*ulCount cycles
#ifdef __TI_COMPILER_VERSION__
	//Code Composer Studio Code
	void Delay(uint32_t ulCount){
	__asm (	"    subs    r0, #1\n"
			"    bne     Delay\n"
			"    bx      lr\n");
}

#else
	//Keil uVision Code
	__asm void
	Delay(uint32_t ulCount)
	{
    subs    r0, #1
    bne     Delay
    bx      lr
	}
#endif

// image of a longhorn
const uint8_t Longhorn[] = {
  0x08, 0x08, 0x08, 0x08, 0x08, 0x18, 0x18, 0x18, 0x38, 0x30, 0x30, 0x30, 0x70, 0xF0,
  0xE0, 0xC0, 0xC0, 0x80, 0x00, 0x00, 0x00, 0x00, 0x00, 0x00, 0x00, 0x00, 0x00, 0x00,
  0x00, 0x00, 0x00, 0x00, 0x00, 0x00, 0x00, 0x00, 0x00, 0x00, 0x00, 0x00, 0x00, 0x00,
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  0x00, 0x00, 0x00, 0x00, 0x00, 0x00, 0x00, 0x00, 0x00, 0x00, 0x00, 0x00, 0x00, 0x00
};

// image of a longhorn loves 319k
const uint8_t Longhorn2[] = {
  0x08, 0x08, 0x08, 0x08, 0x08, 0x18, 0x18, 0x18, 0x38, 0x30, 0x30, 0x30, 0x70, 0xF0,
  0xE0, 0xC0, 0xC0, 0x80, 0x00, 0x00, 0x00, 0x00, 0x00, 0x00, 0x00, 0x00, 0x00, 0x00,
  0x00, 0x00, 0x00, 0x00, 0x00, 0x00, 0x00, 0x00, 0x00, 0x00, 0x00, 0x00, 0x00, 0x00,
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  0x00, 0x00, 0x00, 0x00, 0x00, 0x00, 0x00, 0x00, 0x00, 0x00, 0x00, 0x00, 0x00, 0x00
};


uint8_t love[] = {0x04, 0x0E, 0x1F, 0x3F, 0x7E, 0xFC, 0x7E, 0x3F, 0x1F, 0x0E, 0x04, 0x00};

uint8_t uart_in;
uint8_t uart_out;

uint8_t ST7735_X = 0;
uint8_t ST7735_Y = 0;

uint8_t *x = &ST7735_X;
uint8_t *y = &ST7735_Y;

uint16_t freq;

void Love_Bofei(void){
	Nokia5110_Clear();
	Nokia5110_SetCursor(0,0);
	Nokia5110_OutString("Bofei,");
	Nokia5110_SetCursor(0,2);
	Nokia5110_OutString("Love You So Much!!!");
	Nokia5110_SetCursor(0,5);
	Nokia5110_OutString("Shuxun");
	Nokia5110_SetCursor(6,5);
	Nokia5110_Draw_Partial_Image(love);
}

void Stay_Strong(void){
	Nokia5110_Clear();
	Nokia5110_SetCursor(0,0);
	Nokia5110_OutString("Shuxun,");
	Nokia5110_SetCursor(0,2);
	Nokia5110_OutString("Believe Yourself!");
	Nokia5110_SetCursor(0,4);
	Nokia5110_OutString("Stay Strong");
	Nokia5110_SetCursor(0,5);
	Nokia5110_OutString("H.A.M");
}

void UART_LB(void)
{
	uint8_t Buffer[10];
	uint8_t i, m = 0;
	while(1)
	{
		uart_in = UART1_RX();
		if(uart_in == 13)
		{
			break;
		}
		else{
			Buffer[i] = uart_in;
			i++;
		}
	}
	//UART1_TX(0x30);
	
	for(m = 0; m < i; m++)
	{
		UART1_TX(Buffer[m]);
	}
	
}

void ST7735_KeyBoard(uint8_t x, uint8_t y){
	uint8_t IsBackSpace = 0;
	while(1){ 
		IsBackSpace = 0;		
		uart_in = UART1_RX();
		if(uart_in == 13)
		{
			x = 0;
			y = y + 10;
			continue;
		}
		if(uart_in == 8)
		{
			IsBackSpace = 1;
			if(x >= 6){
				x = x - 6;
			}
			else{
				x = 0;
			}
			uart_in = ' ';
		}
		DrawChar(x, y, uart_in, 0, 0xFFFF, 1);  
		if(!IsBackSpace)
		{
			x = x + 6;
		}
		if(x > 120)
		{
			x = 0;
			y = y + 10;
		}
	}
}

void Universal_SetCursor(uint8_t *x, uint8_t *y){

	uint8_t Buffer[3] = {0, 0, 0};
	uint8_t i, m = 0;
	DebugPort("Input X coordinator");
	while(1)
	{		
		uart_in = UART1_RX();
		if(uart_in == 13)
		{
			*x = 0;
			break;
		}
		else{
			Buffer[i] = uart_in - 0x30;
			i++;
		}
	}
	for(m = i; m > 0; m--)
	{
		*x += Buffer[m-1]*pow(10, i - m);
	}

	
	DebugPort("Input Y coordinator");
	i = 0;
	while(1)
	{		
		uart_in = UART1_RX();
		if(uart_in == 13)
		{
			*y = 0;
			break;
		}
		else{
			Buffer[i] = uart_in - 0x30;
			i++;
		}
	}
	for(m = i; m > 0; m--)
	{
		*y += Buffer[m-1]*pow(10, i - m);
	}
}

/*
void Timer0A_Handler(void){
	TIMER0_ICR_R |= 0x04;	
	DebugPort("Interrupt by PB6");
		UART1_TX(0x46);
	UART_LB();

}


void Timer0A_Handler(void){
	TIMER0_ICR_R |= 0x01;	
	PB4 ^= 0x10;
}
*/
void Timer0A_Handler(void){
	TIMER0_ICR_R |= 0x01;	
	freq = (0xFFFFFF - TIMER0_TBR_R);
	Nokia5110_SetCursor(0,5);
	Nokia5110_OutString("Freq:");
	Nokia5110_OutUDec(freq*0xA);
	Nokia5110_OutString("Hz");
	TIMER0_CTL_R &= ~0x00000100;
	TIMER0_TBILR_R = 0xFFFF;
	TIMER0_TBPR_R = 0xFF;
	TIMER0_CTL_R |= 0x00000100;
}




void Timer1A_Handler(void){
	TIMER1_ICR_R |= 0x04;	
	DebugPort("Interrupt by PB4");

}

int main(void){
	PLL_Init();
	
	UART1_Init(); 
	Nokia5110_Init();
	Nokia5110_Clear();
	//TIMER0_Input_Capture();
	//TIMER1_Input_Capture();
	
	//TIMER0_PWM_Init();
	//TIMER0_PWM_DUTY();
	
	ADC_TIMER1B_Init();
	
	//FreqMeasure_Timer0_Init();
	
	//PWM0_Init(0x7FFF, 0x2FFF);
	
	
	//UART1_TX(0x30);
	//UART_LB();
	ST7735_RInit(INITR_GREENTAB);
	DebugPort("Init Complete");
	//Universal_SetCursor(x, y);
	//DebugPort("Please input on the color screen");
	//ST7735_KeyBoard(ST7735_X, ST7735_Y);
	
	//Delay(16666667); 
	//UART1_Out_String("Finished");
	
	DrawChar(10, 20, 'A', 0, 0xFFFF, 1);
	
	DrawChar(20, 20, 'B', 0x1F7F, 0xFFFF, 1);
	
	DrawChar(30, 20, 'C', 0, 0xFFFF, 1);
	
	DrawChar(40, 20, 'D', 0x02AB, 0xFFFF, 1);
	
	DrawChar(50, 20, 'E', 0, 0xFFFF, 1);
	
	DrawChar(60, 20, 'F', 0, 0xFFFF, 1);
	
	DrawChar(70, 20, 'G', 0xAAAA, 0xFFFF, 1);
	
	DrawChar(80, 20, 'H', 0, 0xFFFF, 1);
	
	DrawChar(90, 20, '8', 0xCCCC, 0xFFFF, 1);
	
	DrawChar(100, 20, '9', 0, 0xFFFF, 1);
	
	DrawChar(110, 20, '?', 0xDDCE, 0xFFFF, 1);
	
	DrawString(10, 60, "ABCDEFGHIJK", 0, 0xFFFF, 1);
	
	//DebugPort("Writing Complete");
	
	/*

	//uart_out = 0x0D;
	 */
	//UART1_TX(uart_out);
	   /*
	Nokia5110_Clear();
	Nokia5110_SetCursor(0,0);
	Nokia5110_OutString("Finished");

	//
                                     // set system clock to 50 MHz



	

	for(count=0; count<5; count=count+1){
    Nokia5110_DrawFullImage(Longhorn);
    Delay(16666667);                    // delay ~1 sec at 50 MHz
    Nokia5110_DrawFullImage(Longhorn2);
    Delay(16666667);                    // delay ~1 sec at 50 MHz
  }
	count = 0;

	while(1){
  Love_Bofei();
  Delay(16666667); 
	Stay_Strong();
	Delay(16666667); 
	}
	*/	
	/*
  Nokia5110_OutString("************* LCD Test *************Letter: Num:------- ---- ");
  Nokia5110_OutChar(127);               // print UT sign
  while(1){
    Nokia5110_SetCursor(5, 5);          // five leading spaces, bottom row
    Nokia5110_OutChar((count%26)+'A');
    Nokia5110_OutChar(' ');
    Nokia5110_OutUDec(count);
    Delay(8333333);                     // delay ~0.5 sec at 50 MHz
    count = count + 1;
  }
	*/
}

